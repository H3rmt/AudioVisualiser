
#include <Adafruit_NeoPixel.h>
#include <Arduino.h>

const int ledCount = 61;

const int ledPin = 3;

const int A_PIN = 5;  // Address pin A connected to digital pin 2
const int B_PIN = 4;  // Address pin B connected to digital pin 3

Adafruit_NeoPixel pixels(ledCount, ledPin, NEO_RGB + NEO_KHZ800);

void setup() {
  pinMode(A_PIN, OUTPUT);
  pinMode(B_PIN, OUTPUT);
  //   pinMode(INH_PIN, OUTPUT);
  //   digitalWrite(INH_PIN, LOW); // Enable the multiplexer
  Serial.begin(115200);

  pixels.begin();
  pixels.setBrightness(50);  // Set brightness to 50%
  pixels.clear();            // Clear the strip
  pixels.show();             // Update the strip
}

void selectChannel(int channel) {
  digitalWrite(A_PIN, channel & 0x01);
  digitalWrite(B_PIN, (channel >> 1) & 0x01);
}

void show() {
  selectChannel(0);
  pixels.show();
  selectChannel(1);
  pixels.show();
  selectChannel(2);
  pixels.show();
}

void zero() {
  for (int i = 0; i < ledCount; i++) {
    pixels.clear();
    pixels.setPixelColor(i, Adafruit_NeoPixel::Color(0, 255, 0));  // Set current LED to green
    show();
    // delay(20);
  }
  for (int i = ledCount - 1; i >= 0; i--) {
    pixels.setPixelColor(i, Adafruit_NeoPixel::Color(100, 100, 100));  // Set current LED to white
    show();
    // delay(10);
  }
  for (int i = 0; i < ledCount; i++) {
    pixels.setPixelColor(i, Adafruit_NeoPixel::Color(230, 0, 0));  // Set current LED to red
    show();
    // delay(10);
  }
  for (int i = ledCount - 1; i >= 0; i--) {
    pixels.setPixelColor(i, Adafruit_NeoPixel::Color(0, 0, 200));  // Set current LED to blue
    show();
    // delay(10);
  }
  for (int i = 0; i < ledCount; i++) {
    pixels.setPixelColor(i, Adafruit_NeoPixel::Color(255, 255, 255));  // Set current LED to white
    show();
    // delay(7);
  }
}

// These are generated by chatgpt

//  1. Rainbow Cycle (classic NeoPixel demo)
void one() {
  for (int j = 0; j < 256 * 1; j++) {  // 3 cycles of all colors on wheel
    for (int i = 0; i < ledCount; i++) {
      pixels.setPixelColor(i, pixels.ColorHSV((i * 65536L / ledCount + j * 256) % 65536));
    }
    show();
  }
}

// 3. Bouncing Dot (Ping Pong Effect)
void three() {
  int tailLength = 4;
  for (int i = 0; i < ledCount * 2; i++) {
    pixels.clear();
    int pos = i < ledCount ? i : (2 * ledCount - i - 1);
    for (int t = 0; t < tailLength; t++) {
      int idx = pos - t;
      if (idx >= 0) {
        pixels.setPixelColor(idx, Adafruit_NeoPixel::Color(255 / (t + 1), 0, 0));
      }
    }
    show();
    delay(5);
  }
}



// 4. Color Wipe with Fade-In
void four() {
  for (int i = 0; i < ledCount; i++) {
    for (int b = 0; b <= 255; b += 20) {
      pixels.setPixelColor(i, Adafruit_NeoPixel::Color(b, 0, b));
      delay(3);
    }
    show();
  }
}

// 5. Pulse (Breathing Effect)
void five() {
  for (int cycle = 0; cycle < 3; cycle++) {
    for (int b = 0; b <= 255; b += 5) {
      for (int i = 0; i < ledCount; i++) {
        pixels.setPixelColor(i, Adafruit_NeoPixel::Color(0, b, 0));
      }
      show();
      delay(10);
    }
    for (int b = 255; b >= 0; b -= 5) {
      for (int i = 0; i < ledCount; i++) {
        pixels.setPixelColor(i, Adafruit_NeoPixel::Color(0, b, b));
      }
      show();
      delay(3);
    }
  }
}

//  6. Color Chase (Shifted Lighting)
void six() {
  int trail = 3;
  for (int i = 0; i < ledCount + trail; i++) {
    pixels.clear();
    for (int t = 0; t < trail; t++) {
      int idx = i - t;
      if (idx >= 0 && idx < ledCount) {
        pixels.setPixelColor(idx, Adafruit_NeoPixel::Color(255, 255 / (t + 1), 0));
      }
    }
    show();
    delay(10);
  }
}

void loop() {
  one();
  three();
  four();
  five();
  six();
}
